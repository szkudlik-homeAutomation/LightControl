## kconfig
```kconfig
menu "Home Automation General empty application"

rsource "src/LightControl/kconfig"

rsource "src/KeyCodeApp/kconfig"

rsource "src/Common_code/kconfig"

config NODE_SCAN_EEPROM_STATUS_TASK
    bool "Enable Node Scan Task with Eeprom statuses"
	default n
    select WORKER_PROCESS
    select TLE8457_COMM_LIB

config SYSTEM_STATUS_SENSOR_INSTANCE
	bool "Enable an instanve of system status sensor sending data to central node"
	default n
	select SENSORS
	select SYSTEM_STATUS_SENSOR
	imply SENSOR_SEND_EVENTS_USING_SERIAL
	help
		sensors IDs are equal to node ID
		
config SYSTEM_STATUS_SENSOR_PERIOD
    int "System status sensor period, in 10ms"
    default 2400
    depends on SYSTEM_STATUS_SENSOR_INSTANCE
    

endmenu
```

## src/KeyCodeApp/kconfig
```kconfig
config KEY_CODE_APP
    bool "compile KeyCode application"
    default n
    select SENSORS
    select WIEGAND_SENSOR
    select TLE8457_COMM_LIB
   
config KEY_CODE_TABLE_SIZE
	int "max number of keycodes in the table"
	depends on KEY_CODE_APP
	default 100
	
config KEYCODE_TIMEOUT 
	int "Timeout in ms for timeout in entering digits" 
    default 2500
	depends on KEY_CODE_APP

config KEYCODE_MAX_DIGITS
	int "Max number of digits in the code"
	default 4
	depends on KEY_CODE_APP

config KEYCODE_WINEGRAND_SENSOR_ID
	int "ID of a sensor reading the data from keypad"
	default 1
	depends on KEY_CODE_APP
	help
		should be set to an unique ID in the system, 
		set it in a global config

config KEY_CODE_APP_TELNET_COMMANDS
	bool "enable telnet commands for remote keycode application control"
    default n
    select TLE8457_COMM_LIB
    select TELNET_SERVER
    select NETWORK
```

## src/LightControl/kconfig
```kconfig
config LIGHT_CONTROL_APP
    bool "compile light control application"
    default n
    select OUTPUT_PROCESS
        
config LIGHT_CONTROL_APP_HTTP_SERVLETS
    bool "add servlets to HTTP server for light control app"
    default n
    depends on LIGHT_CONTROL_APP
    select HTTP_SERVER

config LIGHT_CONTROL_APP_TELNET_COMMANDS
    bool "add telnet commands for light control app"
    default n
    depends on LIGHT_CONTROL_APP
    select TELNET_SERVER

config LIGHT_CONTROL_EEPROM_OUTPUTS_POLARITY
    bool "get outputs polarity from eeprom"
    default n
    depends on LIGHT_CONTROL_APP
    help
    	if this option is enabled, the outputs polarity will be read from eeprom
        otherwise the outputs polarity will be set to "active low"
        eeprom byte should be set during flash programming
        bit set to 0 means active low, 1 active high

config LIGHT_CONTROL_EEPROM_INPUTS_POLARITY
    bool "get input polarity from eeprom"
    default n
    depends on LIGHT_CONTROL_APP
    help
    	if this option is enabled, the inputs polarity will be read from eeprom
        otherwise the outputs polarity will be set to "active low"
        eeprom byte should be set during flash programming
        bit set to 0 means active low, 1 active high


config LIGHT_CONTROL_LOG_INCOMING_EVENTS
    bool "log incoming light control events"
    default n
    depends on LIGHT_CONTROL_APP

config LIGHT_CONTROL_ACTION_TABLE_SIZE
    int "number of actions in EEPROM table"
    default 10
    depends on LIGHT_CONTROL_APP

config LIGHT_CONTROL_CENTRAL_NODE
    bool "light control central node"
    default n
    depends on LIGHT_CONTROL_APP
    help
      this option is enabled, the node will act as a central node 
      It will be able to send detatiled commands to other nodes 
      
```

## west.yml
```yaml
manifest:
  defaults:
    remote: szkudlik-homeAutomation

  remotes:
    - name: szkudlik-homeAutomation
      url-base: https://github.com/szkudlik-homeAutomation

  projects:
    - name: Common_code
      path: src/Common_code
      repo-path: Common_code.git
      import: 
        path-prefix: LightControl
      revision: d5d5b7983962a937ade59cac2bd63ee5e62ac3fc

  self:
      path: LightControl
```
